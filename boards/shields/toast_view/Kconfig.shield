## boards/shields/toast_view/Kconfig.shield
```kconfig
# Copyright (c) 2022 The ZMK Contributors
# SPDX-License-Identifier: MIT

config SHIELD_TOAST_VIEW
    def_bool $(shields_list_contains,toast_view)
```
